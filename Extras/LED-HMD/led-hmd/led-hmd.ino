/*
 * This file is part of uCNC_controller.
 *
 * Copyright (C) 2017  D.Herrendoerfer
 *
 *   uCNC_controller is free software: you can redistribute it and/or modify
 *   it under the terms of the GNU General Public License as published by
 *   the Free Software Foundation, either version 3 of the License, or
 *   (at your option) any later version.
 *
 *   uCNC_controller is distributed in the hope that it will be useful,
 *   but WITHOUT ANY WARRANTY; without even the implied warranty of
 *   MERCHANTABILITY or FITNESS FOR A PARTICULAR PURPOSE.  See the
 *   GNU General Public License for more details.
 *
 *   You should have received a copy of the GNU General Public License
 *   along with uCNC_controller.  If not, see <http://www.gnu.org/licenses/>.
 */

#include "FastLED.h"
 
#define DATA_PIN    6
#define LED_TYPE    WS2812B
#define COLOR_ORDER GRB
#define NUM_LEDS    506
#define BRIGHTNESS  25
 
CRGB leds[NUM_LEDS];

/* pix/Stormtrooper Pixel Head.png */
const PROGMEM unsigned char image0[]={231, 233, 232, 231, 233, 232, 231, 233, 232, 231, 233, 232, 231,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 0, };

/* flaming eye */
const PROGMEM unsigned char image1[]={0, 0, 0, 0, 0, 0, 0, 0, 0, 0, 0, 0, 0,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 0, };

/* pix/smiley-1635449_960_720.png */
const PROGMEM unsigned char image2[]={0, 0, 0, 0, 0, 0, 0, 0, 0, 0, 0, 0, 0,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 0, };
/* pix/smiley-1635451_960_720.png */
const PROGMEM unsigned char image2b[]={0, 0, 0, 0, 0, 0, 0, 0, 0, 0, 0, 0, 0,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 0, };

/* pix/new/smiley-1635449_960_720 Kopie.png */
const PROGMEM unsigned char image3[]={0, 0, 0, 0, 0, 0, 0, 0, 0, 0, 0, 0, 0,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 0, };
/* pix/new/smiley-1635449_960_720.png */
const PROGMEM unsigned char image3b[]={0, 0, 0, 0, 0, 0, 0, 0, 0, 0, 0, 0, 0,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 0, };


/* pix/new/Jack-skellington.jpg */
const PROGMEM unsigned char image4[]={0, 1, 0, 2, 4, 1, 0, 2, 0, 0, 1, 0, 0,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 0, };
/* pix/new/Jack-skellington Kopie.jpg */
const PROGMEM unsigned char image4b[]={0, 1, 0, 3, 5, 2, 0, 1, 0, 0, 1, 0, 0,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 0, };


/* pix/Sally.jpg */
const PROGMEM unsigned char image5[]={2, 2, 2, 1, 1, 1, 1, 0, 0, 2, 2, 1, 3,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 2, };
/* pix/new/scary.png */
const PROGMEM unsigned char image6[]={212, 212, 212, 232, 232, 232, 230, 230, 230, 230, 230, 230, 230,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 0, };
/* pix/new/Pumpkin Pixel Head.png */
const PROGMEM unsigned char image7[]={0, 0, 0, 0, 0, 0, 0, 0, 0, 0, 0, 0, 0,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 0, };

#define NUMIMGS 7

const unsigned char *images[] = { image0, 0,
                                  image1, 0,
                                  image2, image2b,
                                  image3, image3b,
                                  image4, image4b,
                                  image5, 0,
                                  image6, 0,
                                  image7, 0 };



void setup() {
  delay(30); // initial delay of a few seconds is recommended
  FastLED.addLeds<WS2812, DATA_PIN, GRB>(leds, NUM_LEDS);
  FastLED.setBrightness(BRIGHTNESS);// global brightness
  
  /* Switches for the remote control */
  pinMode( 2,INPUT_PULLUP);
  pinMode( 3,INPUT_PULLUP);
}
 

// main program
void loop() {
  int i,a,b,x;
  char red,green,blue;
  b=0;
  a=0;
  
  while ( true ) {
    /* Display an image */
    x=0;
    for ( i=0 ; i < NUM_LEDS ; i++) {
      red = pgm_read_byte(&(images[a+b][x++]));
      green = pgm_read_byte(&(images[a+b][x++]));
      blue = pgm_read_byte(&(images[a+b][x++]));
      leds[i] = CRGB(red, green, blue);
    }
    FastLED.show();
    delay (100);

    /* Switch handling */

    while ( digitalRead(2) == 1 && digitalRead(3) == 1)
      delay(10);

    if (digitalRead(2) == 0) {
      a+=2;
      b=0;
      
      if ( a > (NUMIMGS * 2))
        a=0;
    }

    if (digitalRead(3) == 0)
      if ( images[a+1] != 0)
        b^=1;

    x=0;
    while ( digitalRead(2) != 1 || digitalRead(3) != 1) {
      delay(10);
      x++;
      
      /* Long press handling */
      if ( x == 100 ) {
        for ( i=0 ; i < NUM_LEDS ; i++) {
          leds[i] = CRGB(0, 0, 0);
        }
        FastLED.show();
        while ( digitalRead(2) != 1 || digitalRead(3) != 1)
          delay(10);
        delay(50);
        while ( digitalRead(2) == 1 && digitalRead(3) == 1)
          delay(10);
      }
    }
  }
}
